/dts-v1/;

#include <ti/cc26xx.dtsi>

/ {
	model = "TI CC2650 Sensor Tag";
	compatible = "ti,cc26xx";

	aliases {
		uart_0 = &uart0;
	};

	chosen {
		zephyr,sram = &sram0;
		zephyr,flash = &flash0;
	};
};

&uart0 {
	status = "ok";
};
