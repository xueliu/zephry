## arch/arm/soc/ti_simplelink/cc26xx/Kconfig.defconfig.cc2650
```kconfig
# Kconfig.defconfig.cc2650- TI SimpleLink CC2650 SoC
#

if SOC_CC2650

config SOC
	string
	default cc2650

config SYS_CLOCK_HW_CYCLES_PER_SEC
	int
	default 48000000

if !HAS_DTS
config SRAM_SIZE
	default 20

config FLASH_SIZE
	default 128
endif # !HAS_DTS

config NUM_IRQS
	int
	# must be >= the highest interrupt number used
	# This includes the NWP interrupt
	default 82

config CC26XXWARE_LIBRARY
	def_bool n

if GPIO

config GPIO_CC26XX
	def_bool y

config GPIO_CC26XX_P0
	default n

endif # GPIO

endif # SOC_CC26XX
```

## arch/arm/soc/ti_simplelink/cc26xx/Kconfig.defconfig.series
```kconfig
# Kconfig.defconfig.series - TI SimpleLink 26XX Family
#

if SOC_SERIES_CC26XX

source "arch/arm/soc/ti_simplelink/cc26xx/Kconfig.defconfig.cc26*"

config SOC_SERIES
	default cc26xx

endif # SOC_SERIES_CC26XX
```

## arch/arm/soc/ti_simplelink/cc26xx/Kconfig.series
```kconfig
# Kconfig.series - TI SimpleLink CC26xx
#

config  SOC_SERIES_CC26XX
	bool "TI SimpleLink CC26XX Family"
	select CPU_CORTEX_M
	select CPU_CORTEX_M3
	select SOC_FAMILY_TISIMPLELINK
	select CPU_HAS_SYSTICK
	help
	  Enable support for TI SimpleLink CC26xx
```

## arch/arm/soc/ti_simplelink/cc26xx/Kconfig.soc
```kconfig
# Kconfig.soc - Texas Instruments CC2650
#

choice
prompt "TI SimpleLink 26XX MCU Selection"
depends on SOC_SERIES_CC26XX

config SOC_CC2650
	bool "CC2650"
	select HAS_CC26XXWARE

endchoice
```

## boards/arm/cc2650_sensor_tag/Kconfig.board
```kconfig
# Kconfig - TI SimpleLink CC2650 Sensor Tag Board
#

config  BOARD_CC2650_SENSOR_TAG
	bool "TI CC2650 SENSOR TAG"
	depends on SOC_CC2650
```

## boards/arm/cc2650_sensor_tag/Kconfig.defconfig
```kconfig
# Kconfig - TI CC2650 Sensor Tag board configuration
#

if BOARD_CC2650_SENSOR_TAG

config BOARD
	default cc2650_sensor_tag

endif # BOARD_CC2650_SENSOR_TAG
```

## boards/arm/cc2650_sensor_tag/cc2650_sensor_tag_defconfig
```kconfig
CONFIG_ARM=y
CONFIG_BOARD_CC2650_SENSOR_TAG=y
CONFIG_SOC_FAMILY_TISIMPLELINK=y
CONFIG_SOC_SERIES_CC26XX=y
CONFIG_SOC_CC2650=y
CONFIG_CORTEX_M_SYSTICK=y
CONFIG_PRINTK=y
# 48MHz system clock
CONFIG_SYS_CLOCK_HW_CYCLES_PER_SEC=48000000

#enable GPIO driver
CONFIG_GPIO=y

# enable uart driver
CONFIG_SERIAL=y
CONFIG_SERIAL_HAS_DRIVER=y
CONFIG_UART_CC26XX=y

# enable console
CONFIG_CONSOLE=y
CONFIG_UART_CONSOLE=y

# Enable CC26XXWARE driver files
CONFIG_CC26XXWARE_ROM_DRIVERLIB=y

# Enable DTS parsing
CONFIG_HAS_DTS=y
```

## drivers/gpio/Kconfig.cc26xx
```kconfig
# Kconfig.cc26xx- CC26XX GPIO configuration options
#

menuconfig GPIO_CC26XX
	bool "TI CC26XX GPIO driver"
	depends on GPIO && SOC_FAMILY_TISIMPLELINK
	default n
	help
	  Enable the GPIO driver on TI SimpleLink CC26xx boards

if GPIO_CC26XX

config GPIO_CC26XX_P0
	bool "cc26xx GPIO Port P0 options"
	default n
	help
	  Enable cc26xx GPIO port P0 config options.

config GPIO_CC26XX_P0_DEV_NAME
	string "GPIO Port P0 Device Name"
	depends on GPIO_CC26XX_P0
	default "GPIO_0"
	help
	  Specify the device name to be used for the GPIO port.

config GPIO_CC26XX_PORT_P0_PRI
	int "GPIO Port P0 interrupt priority"
	depends on GPIO_CC26XX_P0
	default 1
	help
	  CC26XX Port P0 IRQ priority.

endif # GPIO_CC26XX
```

## drivers/serial/Kconfig.cc26xx
```kconfig
menuconfig UART_CC26XX
	depends on SOC_SERIES_CC26XX
	bool "CC26XX UART driver"
	default n
	select SERIAL_HAS_DRIVER
	depends on SOC_FAMILY_TISIMPLELINK
	help
	  This option enables the CC26XX UART driver, for UART_0.

config UART_CC26XX_NAME
	string "Device Name for CC26XX UART"
	default "UART_0"
	depends on UART_CC26XX
	help
	  This is the UART's device name binding.
```

## ext/hal/ti/cc26xxware/Kconfig
```kconfig
# Kconfig - CC26XXWARE HAL configuration

config HAS_CC26XXWARE
	bool

menuconfig CC26XXWARE
	bool "TI CC26XXWARE support"
	default n
	depends on HAS_CC26XXWARE
	help
	Set when CC26XXWARE_BUILTIN or CC26XXWARE_LIBRARY

if HAS_CC26XXWARE

config CC26XXWARE_BUILTIN
        bool "Enable building the CC26XXWARE files stored in the Zephyr tree"
        default n
        select CC26XXWARE
        help
        Link with local CC26XXWARE driverlib sources.

config CC26XXWARE_ROM_DRIVERLIB
        bool "Use the Peripheral Driver library functions in ROM"
        default n
        select CC26XXWARE
        help
        Vector to CC26XXWARE driverlib APIs in ROM.

endif
```
